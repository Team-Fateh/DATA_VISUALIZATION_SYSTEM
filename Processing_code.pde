import processing.video.*;
import processing.serial.*;
import controlP5.*;
import java.io.PrintWriter;

Capture video;

PrintWriter output;

ControlP5 cp5; //instance of ControlP5 class created through ControlP5's constructor.

ScrollableList portList;
Button b0;

PFont f1, f2;
PImage logo;

Serial myPort;//instance of Serial class created.

String portInUse=null;

int[] values = new int[18];
//values[0]=millis
//values[1]=RPM
//values[2]=temp
//values[3]=gear
//values[4]=speed
//values[5]=brakepressure
//values[6]=BatteryVoltage
//values[7]=radiator
//values[8]=datalogging
//values[9]=throttle position
//values[10]=braketemp
//values[11]=frontleftloadcell
//values[12]=frontrightloadcell
//values[13]=rearleftloadcell
//values[14]=rearrightloadcell
//values[15]=accelerometer x-axis
//values[16]=accelerometer y-axis
//values[17]=Steering angle
int[] speed = new int[600];
int[] rpm = new int[600];
int[] brakepressure = new int[315];
int[] xAccel = new int[400];
int[] yAccel= new int[400];
//int[] xAccel1 = new int[400];
//int[] yAccel1= new int[400];

PImage Background;
int Numberoflistitems=0;
float offset = 0;
float easing = 0.05;
boolean linkSketched = false;
boolean isRunning=true;

void setup() {
  size(width,height);
  cp5 = new ControlP5(this);//Passed reference to the current sketch object
  surface.setTitle("TEAM FATEH GUI SYSTEM"); //sets the title of the Processing window to "TEAM FATEH GUI SYSTEM". 
  logo = loadImage("LOGO.jpg");// Load an image into the program
  Background=loadImage("BackGround.jpg");
  f1 = createFont("AdobeGothicStd-Bold", 30, true);
  f2 = createFont("Arial", 12);
  image(Background,0,0,width,height);
drawInterface();
BUTTONS();
PORT();
}

void draw() {}

void drawInterface(){
  smooth();
  surface.setIcon(logo);//sets the icon of the Processing window to the image specified by the logo variable.
  image(logo, width - 240, 0,width-1110,height-650);

  textFont(f1);
  fill(#FFF303);
  textAlign(CENTER);
  textSize(50);
  text("TEAM FATEH GUI SYSTEM", width / 2+150, height-750);
  stroke(#FFF303);
  strokeWeight(10);
  fill(0);
  rect(width/2-90,height-700,400,550);
}

void BUTTONS() {
  strokeWeight(2);
  b0 = cp5.addButton("START")
         .setPosition(width/2+40,height-325)
         .setSize(130, 50)
         .setColorBackground(#FFF303)
         .setCaptionLabel("START")
         .setColorLabel(color(0))
         .setColorActive(#FFF303)
         .setColorForeground(0);
         //.setFont(createFont("AdobeGothicStd-Bold",25));
 b0.addListener(
 new ControlListener() {
    public void controlEvent(ControlEvent event) {
      if (event.getName().equals("START")) {
        buttonClicked("START");
      }
    }
  }
);

  b0 = cp5.addButton("EXIT")
          .setPosition(width/2+40,height-265)
         .setSize(130, 50)
         .setColorBackground(#FFF303)
         .setCaptionLabel("EXIT")
         .setColorLabel(color(0))
         .setColorActive(#FFF303)
         .setColorForeground(0);
         //.setFont(createFont("AdobeGothicStd-Bold",25));
 b0.addListener(
 new ControlListener() { 
    //The ControlListener interface is part of the controlP5 library and it defines a method called controlEvent().
    public void controlEvent(ControlEvent event) {
    //controlEvent is a method provided by the PApplet class that we use with ControlListner.
    //ControlEvent class is part of the ControlP5 library in Processing. It is used to represent an event generated by a control element.
      if (event.getName().equals("EXIT")) {//conditional statement that checks if the event's name is equal to "EXIT" using the getName() method. 
        buttonClicked("EXIT");
      }
    }
  }
);
}
void PORT(){
 
  //cp5 = new ControlP5(this);

  String[] portNames = Serial.list();// Get a list of available port names

  portList = cp5.addScrollableList("AVAILABLE PORTS")
                .setPosition(width/2+20, 225)
                .setSize(200, 700)
                .setItemHeight(40)
                .setBarHeight(50)
                .setBackgroundColor(#FFF303)// Sets the background color of the scrollable list.
                .setColorBackground(0)// Sets the background color of the list items.
                .setColorActive(0)
                .setColorValueLabel(#FFF303)
                //.setFont(createFont("AdobeGothicStd-Bold",20))
                .setOpen(false);
                

  for (String portName : portNames) {      
    try {
      Serial port = new Serial(this, portName, 230400); // Replace baud rate with the appropriate one for your device.
      println("Device is connected to port: " + portName);
      port.stop();
      portList.addItem(portName,Numberoflistitems);
   Numberoflistitems++;
}
catch (Exception e) {
      println("Port is busy: " + portName);
    }
  }
  if(Numberoflistitems==0){
  portList.addItem("NO PORT AVAILABLE",Numberoflistitems);
  }
}

//The e.printStackTrace() statement is used to print the stack trace of an exception to the console.


void buttonClicked(String buttonName) {
  if (buttonName.equals("START")) {//.equals() compare the contents of two String objects
   if(Numberoflistitems!=0){
 int selectedIndex = (int) portList.getValue();  
 String selected = portList.getItem((int) selectedIndex).get("name").toString();
 portInUse=selected;
  if(portInUse!=null){
  println(portInUse);
  PApplet.runSketch(new String[] { "MySketch" }, new MySketch());// it runs a new sketch called MySketch using the PApplet.runSketch method.
  }
    //The runSketch() method takes two arguments:
    //An array of strings that specifies the display arguments for the sketch.
    //An instance of the MySketch class
}
 }
  if (buttonName.equals("EXIT")) {
exit()  ;
}
}
class MySketch extends PApplet {
  //MySketch class defines the behavior and drawing functions of the sketch.
  //By extending the PApplet class, the MySketch class inherits all the functionality and methods provided by the PApplet class.
  public void settings(){
  size(1350,860);  
  }
  public void setup() {
  size(1350,860);
  smooth();
  output=createWriter("C:\\Users\\pratham\\Desktop\\FATEH\\DATA_VISUALIZATION_SYSTEM\\data.csv");
  //video=new Capture(this,Capture.list()[0]);
  //video.start();
  myPort = new Serial(this,portInUse,57600);//Initialized myPort 
  cp5=new ControlP5(this);
  for (int i = 0; i < rpm.length; i++) {
    rpm[i] = 0;
    speed[i] = 0;
 }
   for (int i = 0; i < brakepressure.length; i++) {
    brakepressure[i] = 0;
  }
  for (int i = 0; i < xAccel.length; i++) {
    xAccel[i] = 0;
    yAccel[i] = 0;
    //xAccel1[i] = 0;
    //yAccel1[i] = 0;
  }
  runButton(width-730,height-250);
  pauseButton(width-730,height-190);
  }
public void draw(){
if(isRunning){
 background(0);
 //if(video.available()){
 //  video.read();
 //}
 //float targetWidth = width;
 //float targetHeight = targetWidth * 1 / 2.1; // Change the aspect ratio here
 // Calculate the scale factor for width and height
 //float scaleX = targetWidth / video.width;
 //float scaleY = targetHeight / video.height; 
 // Apply the scale transformation
 //pushMatrix();
 //scale(scaleX, scaleY);  
 // Display the video frame
 //image(video, 215, 205, 216, 210);  
 //popMatrix();
 image(logo,470,220,400,365);
  if (myPort.available() > 0) {
    String input = myPort.readStringUntil('\n');
    output.println(input);
    println(input);
    if (input != null) {
     String[] valuesStr = split(input.trim(), ",");
       if (valuesStr.length==18) {
        for (int i = 0; i < values.length; i++) {
          values[i] = int(valuesStr[i]);
        }
      }
    }
  }
  int dataValue = values[0];//millis
  int randValue = values[1];//RPM
  int randValue1 = values[4];//SPEED
  int randValue2 = values[5];//BRAKEpressure
  int randValue3 = values[9];//THROTTLE
  int randValue4 = values[10];//breaktemp
  int randValue5 = values[15];//accelerometerX-axis
  int randValue6 = values[16];//accelerometerY-axis
  for (int i = 0; i < rpm.length-1; i++) {
    rpm[i] = rpm[i+1];
    speed[i]=speed[i+1];
  }
   for (int i = 0; i < brakepressure.length-1; i++) {
    brakepressure[i]=brakepressure[i+1];
  }
    for (int i = 0; i < xAccel.length-1; i++) {
    xAccel[i] = xAccel[i+1];
    yAccel[i] = yAccel[i+1];
    //xAccel1[i] = xAccel1[i+1];
    //yAccel1[i] = yAccel1[i+1];
  }
  
  speed[speed.length-1] = randValue1;
  rpm[rpm.length-1]=randValue;
  brakepressure[brakepressure.length-1]=randValue2;
  xAccel[xAccel.length-1] = randValue5;
  yAccel[yAccel.length-1] = randValue6;
  //xAccel1[xAccel1.length-1] = int(map(randValue5,0,1023,-3,3));
  //yAccel1[yAccel1.length-1] = int(map(randValue6,0,1023,-3,3));
    GAUGE(980,height-160,values[4],"SPEED",150);
    GAUGE(1225,height-150,values[1],"RPM",11000);
    GRAPH(600,150,speed,"SPEED",20,10,150);
    GRAPH(600,150,rpm,"RPM",690,10,11000);
    GRAPH2(400,85,xAccel,yAccel,"G's",30,240,3);
    BAR(800,height-170, values[5],"BREAK PRESSURE",100);
    G(values[15],values[16],200,500);
    ONOFF(width-300,540,values[7],"R");//RADIATOR
    ONOFF(width-100,540,values[8],"D");//DATALOGGING
    RAWDATA(1150,250);
    textAlign(CENTER,CENTER);
    fill(255);
    textSize(50);
    text("GEAR",100,600);
    textSize(30);
    text("BATTERY VOLT",510,600);
    text("ENGINE TEMP",320,600);
    textSize(70);
    fill(255, 204, 0);
    if(values[3]==0){
      text("N",100,650);
    }
    else{
        text(values[3],100,650);
    }
    textSize(50);
    text("°C",350,650);
    text("V",515,650);
    text(values[2],300,650);
    text(values[6],480,650);
    textSize(30);
    text("G's",170,220);
    noFill();
}            
}
public void GAUGE(int X,int Y,int value,String label,int maxvalue){
strokeWeight(25);
  pushMatrix();
  translate(X,Y);
  stroke(255, 204, 0);
  noFill();
  arc(0,0,200,200,-PI, map(value, 0,maxvalue,-PI,0));
  fill(255);
  textAlign(CENTER, CENTER);
  textSize(30);
  text(label,0,-60);
  text(value,0,-30);
  popMatrix();
}
public void GRAPH(float w, float h, int[] data, String label, int x,int  y, int maxValue){
  pushMatrix();
  translate(x,y);
  int i=0, x1=0, x2 = 0, y1=0, y2 = 0;
  int pointInterval = int(w / data.length);
  strokeWeight(2);
  stroke(255, 204, 0);
  for (i = 1; i < data.length; i++) {
    x1 =(i-1) * pointInterval;
    y1 = int(h - (data[i-1] * h / maxValue));
    x2 =i * pointInterval;
    y2 = int(h - (data[i] * h / maxValue));
    line(x1, y1, x2, y2);
  }
  fill(255, 204, 0);
  textSize(20);
  text(data[i-1], x2 + 20, y2 - 5);
  text(label, 1870,75);
  stroke(255);
  line(0,0,w,0);
  line(0,h,w,h);
  textSize(20);
  text(label,w+25,h/2);
  for(i = 0; i<=10; i++){
   line(((w/10)* i),0,((w/10)* i),h); 
   text(i -10,((w/10)* i),h+20);
  }
   popMatrix();
}
public void GRAPH2(float w, float h, int[] data,int[] data2, String label, int x,int  y, int maxValue){
  pushMatrix();
  translate(x,y);
  int i=0, x1=0, x2 = 0, y1=0, y2 = 0;
  int j=0, x3=0, x4 = 0, y3=0, y4 = 0;
  int pointInterval = int(w / data.length);
  strokeWeight(2);
  stroke(255, 204, 0);
  for (i = 1; i < data.length; i++) {
    println(x1);
    println(y1);
    x1 =(i-1) * pointInterval;
    y1 = int(h - (data[i-1] *h / maxValue));
    x2 =i * pointInterval;
    y2 = int(h - (data[i] *h / maxValue));
    line(x1, y1, x2, y2);
  }
  int pointInterval2 = int(w / data2.length);
  stroke(255);
  for (j = 1; j < data2.length; j++) {
    x3 =(j-1) * pointInterval2;
    y3 = int(h - (data2[j-1] *h / maxValue));
    x4 =j * pointInterval2;
    y4 = int(h - (data2[j] *h / maxValue));
    line(x3, y3, x4, y4);
  }
  fill(255, 204, 0);
  textSize(20);
  text(data[i-1], x2 + 20, y2 - 5);
  text(label, 1870,75);
  stroke(255);
  line(0,0,w,0);
  line(0,2*h,w,2*h);
  textSize(20);
  text(label,w+25,2*h);
  for(i = 0; i<=10; i++){
   line((w/10* i),0,(w/10* i),2*h); 
   line(0,h,w,h);
   text(i -10,((w/10)* i)-10,h+20);
  }
  popMatrix();
}
public void BAR(float x, float y, int value, String label, int maxValue){
  pushMatrix();
  translate(x,y);
  float barHeight = map(value, 0, maxValue, 0, 100);
  noStroke();
  fill(255, 204, 0);
  rect(0 - 20, -barHeight, 40, barHeight);
  fill(255);
  textAlign(CENTER, CENTER);
  textSize(30);
  text(value, 0,10);
  textSize(20);
  text(label, 20,30);
  popMatrix();
}
public void G(int v1,int v2,int X,int Y){
  pushMatrix();
  translate(X,Y);
  noFill();
  stroke(255);
  ellipse(0,0,150,150);
  ellipse(0,0,100,100);
  ellipse(0,0,50,50);
  line(0,-75,0,75);
  line(-75,0,75,0);
  noStroke();
  fill(255, 204, 0);
  ellipse(v1,v2,10,10);
  fill(255);
  textSize(50);
  popMatrix();
}
public void RAWDATA(int X,int Y){
  pushMatrix();
  translate(X,Y);
  fill(255, 204, 0);
   textAlign(CENTER,CENTER);
   textSize(50);
    text("RAWDATA",0,5);
    fill(255);
    textSize(20);
    textAlign(LEFT);
    text("MILLIS-",-210,70);
    text("SPEED-",-210,110);
    text("RPM-",-210,150);
    text("BRAKEPRESSURE-",-210,180);
    text("BATTERY VOLT-",-210,220);
    text("ENGINE TEMP-",20,70);
    text("GEAR-",20,110);
    //text("THROTTLE",20,150);
    text("G(X)-",20,150);
    text("G(Y)-",20,180);
    textAlign(LEFT);
    fill(255, 204, 0);
    text(values[0],-50,70);
    text(values[4],-50,110);
    text(values[1],-50,150);
    text(values[5],-50,180);
    text(values[6],-50,220);
    text(values[2],170,70);
    if(values[3]==0){
      text("N",170,110);
    }
    else{
        text(values[3],170,110);
    }
    //text(values[9],170,150);
    text(values[16],170,150);
    text(values[15],170,180);
    popMatrix();
}
public void ONOFF(int x,int y,int value,String S){
pushMatrix();
translate(x,y);
if(value==0){
stroke(0);
fill(255,0,0);
ellipse(0,0,70,70);
fill(0);
textSize(30);
text(S,0,-4);
}
else{
stroke(0);
fill(#1AC918);
ellipse(0,0,70,70);
fill(0);
textSize(30);
text(S,0,-4);
}
popMatrix();
}

public void runButton(int xPosition,int yPosition){
b0=cp5.addButton("RUN")
.setValue(1)
.setPosition(xPosition,yPosition)
.setSize(100,50)
.setCaptionLabel("RUN")
//.setFont(createFont("AdobeFanHeitiStd-Bold", 16)) // Set font size and style 
 .setColorBackground(color(255, 204, 0))
         .setColorForeground(0)
         .setColorActive(color(255, 204, 0));
b0.addListener(
 new ControlListener() {
    public void controlEvent(ControlEvent event) {
      if (event.getName().equals("RUN")) {
        run();
}
    }
  }
);
}

public void pauseButton(int xPosition,int yPosition){
b0=cp5.addButton("PAUSE")
.setValue(2)
.setPosition(xPosition,yPosition)
.setSize(100,50)
.setCaptionLabel("PAUSE")
//.setFont(createFont("AdobeFanHeitiStd-Bold", 16))// Set font size and style 
 .setColorBackground(color(255, 204, 0))
         .setColorForeground(0)
         .setColorActive(color(255, 204, 0));
b0.addListener(
 new ControlListener() {
    public void controlEvent(ControlEvent event) {
      if (event.getName().equals("PAUSE")) {
        pause();
      }
    }
  }
);
}

public void run(){
  isRunning=true;
}

public void pause(){
  isRunning=false;
}
}
